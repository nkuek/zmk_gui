## config/behaviors/Kconfig
```kconfig
menuconfig ZMK_BEHAVIOR_ART_CYCLE
    bool "Art cycle behavior"
    depends on ZMK_DISPLAY_STATUS_SCREEN_CUSTOM
    select ZMK_DISPLAY

if ZMK_BEHAVIOR_ART_CYCLE
    config ZMK_BEHAVIOR_ART_CYCLE_DEFAULT
        bool "Enable art cycle by default"
        default y
endif
```

## config/boards/shields/nice_view_custom/Kconfig
```kconfig
menuconfig ZMK_BEHAVIOR_ART_CYCLE
    bool "Art cycle behavior"
    depends on ZMK_DISPLAY_STATUS_SCREEN_CUSTOM
```

## config/dts/bindings/behaviors/zmk,behavior-art-auto.yml
```yaml
description: Art Auto Toggle Behavior
compatible: "zmk,behavior-Art-Auto"

include: zero_param.yaml
```

## config/dts/bindings/behaviors/zmk,behavior-art-cycle.yml
```yaml
description: Art Cycle Behavior

compatible: "zmk,behavior-art-cycle"

include: zero_param.yaml

properties:
    label:
        type: string
        required: false
        description: Unique label for the behavior
```
